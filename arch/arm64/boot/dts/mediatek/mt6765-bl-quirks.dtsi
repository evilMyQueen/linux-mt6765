// SPDX-License-Identifier: (GPL-2.0 OR MIT)
/*
 * Quriks for MT6765 mediatek bootloader (little-kernel)
 *
 * Copyright (c) 2023 Arseniy Velikanov <adomerlee@gmail.com>
 */

/ {
    /* FIXES: [SCP] platform_fdt_scp: getting node from dtb fails */
    scp@10500000 {
        compatible = "mediatek,scp";
        status = "okay";
        reg = <0x00 0x10500000 0x00 0x40000 0x00 0x105c0000 0x00 0x3000 0x00 0x105c4000 0x00 0x1000 0x00 0x105d4000 0x00 0x6000>;
        interrupts = <0x00 0xc0 0x04>;
        core_1 = "enable";
        scp_sramSize = <0x40000>;
        scp_feature_tbl = <0x00 0x2f 0x01 0x164 0x02 0x3e 0x03 0x2f 0x04 0x1a 0x05 0x00 0x06 0xc8 0x07 0x00 0x08 0x64 0x09 0x0a>;
        scp_mem_key = "mediatek,reserve-memory-scp_share";
        scp_mem_tbl = <0x01 0x100000 0x04 0x200000>;
    };
};


